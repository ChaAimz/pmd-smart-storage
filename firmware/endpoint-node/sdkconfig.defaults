## firmware/endpoint-node/sdkconfig.defaults
```kconfig
# Bluetooth Configuration
CONFIG_BT_ENABLED=y
CONFIG_BT_BLUEDROID_ENABLED=y
CONFIG_BT_BLE_ENABLED=y
CONFIG_BT_NIMBLE_ENABLED=n
CONFIG_BT_CONTROLLER_ENABLED=y
CONFIG_BT_BLUEDROID_PINNED_TO_CORE_0=y
CONFIG_BT_BTU_TASK_STACK_SIZE=4096
CONFIG_BT_CLASSIC_ENABLED=n
CONFIG_BT_GATTS_ENABLE=y
CONFIG_BT_GATTC_ENABLE=y
CONFIG_BT_BLE_42_FEATURES_SUPPORTED=y

# BLE Mesh Configuration
CONFIG_BLE_MESH=y
CONFIG_BLE_MESH_NODE=y
CONFIG_BLE_MESH_PB_ADV=y
CONFIG_BLE_MESH_PB_GATT=y
CONFIG_BLE_MESH_PROXY=y
CONFIG_BLE_MESH_GATT_PROXY_SERVER=y

# BLE Mesh Models
CONFIG_BLE_MESH_CFG_SRV=y
CONFIG_BLE_MESH_GENERIC_SERVER=y
CONFIG_BLE_MESH_GENERIC_ONOFF_SRV=y
CONFIG_BLE_MESH_GENERIC_CLIENT=y
CONFIG_BLE_MESH_GENERIC_ONOFF_CLI=y

# BLE Mesh Storage (CRITICAL for preserving provisioning data)
CONFIG_BLE_MESH_SETTINGS=y
CONFIG_BLE_MESH_STORE_TIMEOUT=2
CONFIG_BLE_MESH_SEQ_STORE_RATE=128
CONFIG_BLE_MESH_RPL_STORE_TIMEOUT=5

# NVS Configuration for BLE Mesh persistence
CONFIG_NVS_ENCRYPTION=n

# Power Management
CONFIG_PM_ENABLE=y
CONFIG_PM_DFS_INIT_AUTO=y

# Deep Sleep
# CONFIG_ESP_SLEEP_POWER_DOWN_FLASH=y  # Disabled to preserve NVS data
CONFIG_ESP_SLEEP_RTC_BUS_ISO_WORKAROUND=y
CONFIG_ESP_SLEEP_GPIO_RESET_WORKAROUND=y

# FreeRTOS
CONFIG_FREERTOS_HZ=1000
CONFIG_FREERTOS_USE_TICKLESS_IDLE=y

# ESP32-C6 Specific
CONFIG_ESP32C6_DEFAULT_CPU_FREQ_160=y

# Logging - Only essential logs
CONFIG_LOG_DEFAULT_LEVEL_WARN=y
CONFIG_LOG_MAXIMUM_LEVEL_INFO=y

# Component-specific log levels (suppress verbose logs)
CONFIG_LOG_MAXIMUM_BT_LEVEL_WARN=y
CONFIG_LOG_COLORS=y

# Optimization
CONFIG_COMPILER_OPTIMIZATION_SIZE=y

# Bluetooth Controller
CONFIG_BT_CTRL_BLE_MAX_ACT=10
CONFIG_BT_CTRL_BLE_MAX_ACT_EFF=10

# Network
CONFIG_BT_NIMBLE_MAX_CONNECTIONS=3

# Memory
CONFIG_ESP_MAIN_TASK_STACK_SIZE=4096
CONFIG_ESP_SYSTEM_EVENT_TASK_STACK_SIZE=3072

# Partition Table
CONFIG_PARTITION_TABLE_CUSTOM=y
CONFIG_PARTITION_TABLE_CUSTOM_FILENAME="partitions.csv"
CONFIG_PARTITION_TABLE_FILENAME="partitions.csv"

# Flash Size
CONFIG_ESPTOOLPY_FLASHSIZE_4MB=y
CONFIG_ESPTOOLPY_FLASHSIZE="4MB"
```

## firmware/gateway-node/sdkconfig.defaults
```kconfig
# Bluetooth Configuration
CONFIG_BT_ENABLED=y
CONFIG_BT_BLUEDROID_ENABLED=y
CONFIG_BT_BLE_ENABLED=y
CONFIG_BT_NIMBLE_ENABLED=n
CONFIG_BT_CONTROLLER_ENABLED=y
CONFIG_BT_BLUEDROID_PINNED_TO_CORE_0=y
CONFIG_BT_BTU_TASK_STACK_SIZE=4096

# Bluedroid Host
CONFIG_BT_CLASSIC_ENABLED=n
CONFIG_BT_GATTS_ENABLE=y
CONFIG_BT_GATTC_ENABLE=y
CONFIG_BT_BLE_42_FEATURES_SUPPORTED=y
CONFIG_BT_GATTS_SEND_SERVICE_CHANGE_MANUAL=n
CONFIG_BT_BLE_ACT_SCAN_REP_ADV_SET=y

# BLE Mesh Configuration
CONFIG_BLE_MESH=y
CONFIG_BLE_MESH_NODE=y
CONFIG_BLE_MESH_PB_ADV=y
CONFIG_BLE_MESH_PB_GATT=y
CONFIG_BLE_MESH_PROXY=y
CONFIG_BLE_MESH_GATT_PROXY_SERVER=y

# BLE Mesh Models
CONFIG_BLE_MESH_CFG_SRV=y
CONFIG_BLE_MESH_GENERIC_SERVER=y
CONFIG_BLE_MESH_GENERIC_ONOFF_SRV=y
CONFIG_BLE_MESH_GENERIC_CLIENT=y
CONFIG_BLE_MESH_GENERIC_ONOFF_CLI=y

# BLE Mesh Storage (CRITICAL for preserving provisioning data)
CONFIG_BLE_MESH_SETTINGS=y
CONFIG_BLE_MESH_STORE_TIMEOUT=2
CONFIG_BLE_MESH_SEQ_STORE_RATE=128
CONFIG_BLE_MESH_RPL_STORE_TIMEOUT=5
CONFIG_BLE_MESH_STORE_TIMEOUT=2

# NVS Configuration for BLE Mesh persistence
CONFIG_NVS_ENCRYPTION=n

# WiFi Configuration
CONFIG_ESP_WIFI_SSID="YOUR_WIFI_SSID"
CONFIG_ESP_WIFI_PASSWORD="YOUR_WIFI_PASSWORD"
CONFIG_ESP_MAXIMUM_RETRY=5
CONFIG_ESP_WIFI_AUTH_WPA2_PSK=y
CONFIG_ESP_WIFI_SCAN_AUTH_MODE_THRESHOLD_OPEN=y

# LWIP
CONFIG_LWIP_MAX_SOCKETS=16

# MQTT
CONFIG_MQTT_PROTOCOL_311=y

# ESP32-C6 Specific
CONFIG_ESP32C6_DEFAULT_CPU_FREQ_160=y

# Partition Table
CONFIG_PARTITION_TABLE_CUSTOM=y
CONFIG_PARTITION_TABLE_CUSTOM_FILENAME="partitions.csv"
CONFIG_PARTITION_TABLE_FILENAME="partitions.csv"

# Flash Size
CONFIG_ESPTOOLPY_FLASHSIZE_4MB=y
CONFIG_ESPTOOLPY_FLASHSIZE="4MB"

# Logging - Only essential logs
CONFIG_LOG_DEFAULT_LEVEL_WARN=y
CONFIG_LOG_MAXIMUM_LEVEL_INFO=y
CONFIG_ESP_WIFI_DEBUG_LOG_ENABLE=n

# Component-specific log levels (suppress verbose logs)
CONFIG_LOG_MAXIMUM_MQTT_LEVEL_WARN=y
CONFIG_LOG_MAXIMUM_TRANSPORT_LEVEL_WARN=y
CONFIG_LOG_MAXIMUM_BT_LEVEL_WARN=y
CONFIG_LOG_MAXIMUM_WIFI_LEVEL_WARN=y

# Enable INFO level only for our application
CONFIG_LOG_COLORS=y

# FreeRTOS
CONFIG_FREERTOS_HZ=1000

# Memory
CONFIG_ESP_MAIN_TASK_STACK_SIZE=8192
CONFIG_ESP_SYSTEM_EVENT_TASK_STACK_SIZE=4096

# Bluetooth Controller
CONFIG_BT_CTRL_BLE_MAX_ACT=10
CONFIG_BT_CTRL_BLE_MAX_ACT_EFF=10

# Network Stack
CONFIG_LWIP_IRAM_OPTIMIZATION=y
CONFIG_LWIP_MAX_ACTIVE_TCP=16
CONFIG_LWIP_MAX_LISTENING_TCP=16
```
